## HAL_KernelDriver_GA1AUV100WP_V202/kernel/drivers/uv_light/Kconfig
```kconfig
menu "UV & Light Sensor"

config UV_LIGHT
	tristate "enable UV_LIGHT"
	default m

config UV_LIGHT_DEBUG
    bool "Debug UV_LIGHT calls"
	default n

endmenu
```

## zeusis-ts-1217/touchscreen/zeusis_pad/Kconfig
```kconfig
#
# zeusis touchscreen driver configuration
#

config TOUCHSCREEN_ZEUSIS_PAD
	bool "zeusis touchpad"
	default n
	help
	  If you say yes here you get support for zeusis touchscreen.

config ZEUSIS_TS_TEST
	bool "zeusis touchpad test"
	default n
	help
	  If you say yes here you get support for zeusis touchscreen.

source "drivers/input/touchscreen/zeusis_pad/panel_pad/Kconfig"
source "drivers/input/touchscreen/zeusis_pad/panel_pad/cyttsp5/Kconfig"

#sensor unification for differ platform
menu "zeusis linux device driver support package"
config ZEUSIS_TP_COLOR_INFO
	bool "zeusis tp color info"
	default n
	help
		get the zeusis tp color information.
endmenu
```

## zeusis-ts-1217/touchscreen/zeusis_pad/panel_pad/Kconfig
```kconfig
#
# zeusis touchscreen driver configuration
#

config TOUCHSCREEN_SYNAPTICS_PAD
	bool "synaptics touchscreen"
	default n
	help
	  If you say yes here you get support for synaptics touchscreen.
config TOUCHSCREEN_GOODIX_PAD
	bool "goodix touchscreen"
	default n
	help
	  If you say yes here you get support for goodix touchscreen.
config SYNAPTICS_LCD_TYPE
	bool "synaptics touchscreen"
	default n
	help
	  If you say yes here you get support for synaptics touchscreen.
config CYPRESS_PAD
	bool "cypress touchscreen"
	default n
	help
	  If you say yes here you get support for cypress touchscreen.
config WACOM_PAD
	bool "wacom touchscreen"
	default n
	help
	  If you say yes here you get support for wacom touchscreen.
config HIDEEP_PAD
	bool "hideep crimson touchscreen"
	default n
	help
	  If you say yes here you get support for hideep touchscreen.
config HI3630_TS_FW_BUILD
	bool "K3V3 FW"
	default y
	help
	  If you say yes here you build FW in HI3630.
config HI3635_TS_FW_BUILD
	bool "K3V3PLUS FW"
	default y
	help
	  If you say yes here you build FW in HI3635.
config HI6220_TS_FW_BUILD
	bool "HI6220 FW"
	default y
	help
	  If you say yes here you build FW in HI6210.
```

## zl1-code/kernel/drivers/input/goodix/Kconfig
```kconfig
config GOODIX_GF5118M
	tristate "Goodix GFX18M fingerprint drvier support"
	help
	  Say Y here to enable goodix fingerprint driver support!  
```
